## drivers/bluetooth/skwbt/Kconfig.txt
```kconfig
config SKW_BT
        tristate "Seekwave BT driver"
        depends on (SEEKWAVE_BSP_DRIVERS || SEEKWAVE_BSP_DRIVERS_V20) && MMC
        help
          The driver for seekwave Bluetooth chipsets with SDIO/USB interface.

          Say Y here to compile support for Seekwave BT-over-SDIO/USB driver
          into the kernel or say M to compile it as module.
```

## drivers/misc/seekwaveplatform_v20/Kconfig
```kconfig
menuconfig SEEKWAVE_BSP_DRIVERS_V20
        bool "SeekWave Platform Drivers For SeekWave Chip"
        default n
        help
        This is support seekwave chip for incard board
        if you want to buildin bsp driver
        please say "y" 
        Thanks.

config SEEKWAVE_PLD_RELEASE
    bool "seekwave Platfrom support chip recoverymode"
    depends on SEEKWAVE_BSP_DRIVERS_V20
    default n

#seekwave`s wifi bluetooth device driver etc
if  SEEKWAVE_BSP_DRIVERS_V20
source "drivers/misc/seekwaveplatform_v20/usb/Kconfig"
source "drivers/misc/seekwaveplatform_v20/sdio/Kconfig"
source "drivers/misc/seekwaveplatform_v20/skwutil/Kconfig"
source "drivers/misc/seekwaveplatform_v20/pcie/Kconfig"
endif
```

## drivers/misc/seekwaveplatform_v20/usb/Kconfig
```kconfig
config SKW_USB
	tristate "SeekWave USB Support"
	depends on USB ||COMPILE_TEST ||SEEKWAVE_BSP_DRIVERS_V20
	default n
	help
	  Enable this module for WCN_USB
	  chip usb interface bus Support.
	  Please insmod this module before any other
	  WCN subsystems. Thanks.
```
